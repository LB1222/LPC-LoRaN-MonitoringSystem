/*
*********************************************************************************************************
*
*	模块名称 : OLED显示屏驱动模块
*	文件名称 : bsp_OLED.c
*	版    本 : V1.0
*	说    明 : 驱动OLED，配合工程使用，非完整文件
*
*	修改记录 :
*		版本号  日期        作者     说明
*		V1.0    2023-04-19  刘斌  正式发布
*
*	
*
*********************************************************************************************************
*/

#include "bsp.h"


/*引脚配置*/
#define OLED_W_SCL(x)		GPIO_WriteBit(GPIOB, GPIO_Pin_9, (BitAction)(x))
#define OLED_W_SDA(x)		GPIO_WriteBit(GPIOB, GPIO_Pin_8, (BitAction)(x))

uint8_t OLED_F8x16[][16]=
{
	0x00,0x00,0x00,0x00,0x00,0x00,0x00,0x00,
	0x00,0x00,0x00,0x00,0x00,0x00,0x00,0x00,//  0
	
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	0x00,0x00,0x00,0x00,0x00,0x00,0x00,0x00,//~ 94
};
//楷体12  16 16文字
uint8_t T_text[10][32]=
{
		/*--  文字:  刘  --*/
		/*--  楷体12;  此字体下对应的点阵为：宽x高=16x16   --*/
		0x00,0x00,0x60,0xE0,0xEC,0x2C,0xFC,0xF0,0x70,0xE0,0xE0,0xE6,0xFE,0xFC,0x00,0x00,
		0x00,0x20,0x30,0x38,0x1F,0x0F,0x0F,0x1D,0x18,0x07,0x17,0x70,0x7F,0x7F,0x00,0x00,

		/*--  文字:  斌  --*/
		/*--  楷体12;  此字体下对应的点阵为：宽x高=16x16   --*/
		0x00,0x40,0x40,0x48,0xF8,0xF0,0xA0,0xA0,0xA0,0xFE,0xFE,0xFC,0x58,0x58,0x00,0x00,
		0x00,0x10,0x19,0x0F,0x1F,0x1F,0x1F,0x1F,0x1F,0x0F,0x0B,0x0F,0x3E,0x70,0x70,0x00,

		/*--  文字:  牛  --*/
		/*--  楷体12;  此字体下对应的点阵为：宽x高=16x16   --*/
		0x00,0x00,0x00,0x40,0x78,0x38,0x38,0xFE,0xFE,0xFE,0xB0,0xB0,0x80,0x80,0x80,0x00,
		0x00,0x03,0x03,0x03,0x03,0x03,0x01,0xFF,0xFF,0x3F,0x01,0x01,0x01,0x01,0x01,0x00,

				/*--  文字:  节  --*/
		/*--  楷体12;  此字体下对应的点阵为：宽x高=16x16   --*/
		0x00,0x10,0x90,0x98,0x98,0xFC,0xFC,0xC8,0xC8,0x5E,0xDE,0xEA,0xCC,0x0C,0x08,0x00,
		0x00,0x00,0x00,0x00,0x00,0x00,0xFF,0xFF,0x3F,0x18,0x1F,0x1F,0x0F,0x00,0x00,0x00,

		/*--  文字:  点  --*/
		/*--  楷体12;  此字体下对应的点阵为：宽x高=16x16   --*/
		0x00,0x00,0x00,0x00,0x80,0x80,0x82,0xFE,0xFC,0xD0,0xD8,0xD8,0x98,0x00,0x00,0x00,
		0x00,0x60,0x78,0x78,0x03,0x37,0x37,0x24,0x1C,0x3F,0x37,0x0F,0x38,0x38,0x30,0x00,

		/*--  文字:  网  --*/
		/*--  楷体12;  此字体下对应的点阵为：宽x高=16x16   --*/
		0x00,0x00,0x08,0xF8,0xF8,0x88,0xE8,0xE8,0xA8,0xEC,0xEC,0xFC,0xFC,0xF8,0x00,0x00,
		0x00,0x00,0x38,0x3F,0x3F,0x07,0x03,0x03,0x03,0x01,0x33,0x7F,0x7F,0x3F,0x00,0x00,

		/*--  文字:  关  --*/
		/*--  楷体12;  此字体下对应的点阵为：宽x高=16x16   --*/
		0x00,0x00,0x00,0x00,0x4C,0x7C,0xF8,0xE0,0xF0,0x7E,0x6E,0xA6,0x80,0x00,0x00,0x00,
		0x00,0x00,0x43,0x63,0x33,0x3B,0x1F,0x0F,0x0F,0x1D,0x79,0x71,0x61,0x61,0x40,0x00,




	
};

//宋体 12 17 16文字
uint8_t Tep_text[10][34]={
/*--  文字:  温  --*/
/*--  宋体12;  此字体下对应的点阵为：宽x高=17x16   --*/
0x10,0x70,0x62,0x8E,0x8C,0x00,0xFE,0xFE,0x92,0x92,0x92,0x92,0xFE,0xFE,0x00,0x00,
0x00,0x04,0x04,0x7E,0x7F,0x41,0x7E,0x7E,0x42,0x7E,0x7E,0x7E,0x7E,0x42,0x7E,0x7E,
0x40,0x00,

/*--  文字:  度  --*/
/*--  宋体12;  此字体下对应的点阵为：宽x高=17x16   --*/
0x00,0x00,0xFC,0xFC,0x24,0x24,0xFC,0xFD,0x27,0x26,0xFC,0xFC,0x24,0x24,0x24,0x04,
0x00,0x40,0x70,0xBF,0x8F,0x84,0xCC,0x5D,0x75,0x25,0x25,0x75,0x5D,0xCC,0x80,0x80,
0x80,0x00,

/*--  文字:  ：  --*/
/*--  宋体12;  此字体下对应的点阵为：宽x高=17x16   --*/
0x00,0x00,0x00,0x00,0x00,0x00,0x00,0x00,0x00,0x00,0x00,0x00,0x00,0x00,0x00,0x00,
0x00,0x00,0x00,0x36,0x36,0x36,0x00,0x00,0x00,0x00,0x00,0x00,0x00,0x00,0x00,0x00,
0x00,0x00,
	
/*--  文字:  湿  --*/
/*--  宋体12;  此字体下对应的点阵为：宽x高=17x16   --*/
0x10,0x70,0x62,0x8E,0x8C,0xFE,0xFE,0x92,0x92,0x92,0x92,0x92,0xFE,0xFE,0x00,0x00,
0x00,0x04,0x04,0x7E,0x7F,0x45,0x4C,0x58,0x7F,0x7F,0x40,0x7F,0x7F,0x58,0x4C,0x44,
0x40,0x00,

/*--  文字:  度  --*/
/*--  宋体12;  此字体下对应的点阵为：宽x高=17x16   --*/
0x00,0x00,0xFC,0xFC,0x24,0x24,0xFC,0xFD,0x27,0x26,0xFC,0xFC,0x24,0x24,0x24,0x04,
0x00,0x40,0x70,0xBF,0x8F,0x84,0xCC,0x5D,0x75,0x25,0x25,0x75,0x5D,0xCC,0x80,0x80,
0x80,0x00,

/*--  文字:  ℃  --*/
/*--  宋体12;  此字体下对应的点阵为：宽x高=17x16   --*/
0x06,0x0F,0x09,0xEF,0xFE,0xFC,0x0C,0x06,0x02,0x02,0x02,0x02,0x06,0x1E,0x1E,0x00,
0x00,0x00,0x00,0x00,0x07,0x1F,0x3F,0x30,0x60,0x40,0x40,0x40,0x40,0x60,0x30,0x10,
0x00,0x00,


};
  //宋体12 9 16 字符

uint8_t Tep_char[10][18]={
/*--  文字:  .  --*/
/*--  宋体12;  此字体下对应的点阵为：宽x高=9x16   --*/
0x00,0x00,0x00,0x00,0x00,0x00,0x00,0x00,0x00,0x00,0x30,0x30,0x30,0x00,0x00,0x00,
0x00,0x00,
	/*--  文字:  %  --*/
/*--  宋体12;  此字体下对应的点阵为：宽x高=9x16   --*/
0xF0,0xF8,0xF8,0xF0,0xE0,0x78,0x18,0x00,0x00,0x00,0x31,0x3D,0x0F,0x1F,0x3F,0x3F,
0x1E,0x00,

/*--  文字:  R  --*/
/*--  宋体12;  此字体下对应的点阵为：宽x高=9x16   --*/
0x08,0xF8,0xF8,0x88,0x88,0x88,0xF8,0x70,0x00,0x20,0x3F,0x3F,0x20,0x03,0x0F,0x3C,
0x30,0x20,

/*--  文字:  H  --*/
/*--  宋体12;  此字体下对应的点阵为：宽x高=9x16   --*/
0x08,0xF8,0xF8,0x08,0x00,0x08,0xF8,0xF8,0x08,0x20,0x3F,0x3F,0x21,0x01,0x21,0x3F,
0x3F,0x20,

	/*--  文字:  L  --*/
/*--  宋体12;  此字体下对应的点阵为：宽x高=9x16   --*/
0x08,0xF8,0xF8,0x08,0x00,0x00,0x00,0x00,0x00,0x20,0x3F,0x3F,0x20,0x20,0x20,0x30,
0x30,0x00,

/*--  文字:  O  --*/
/*--  宋体12;  此字体下对应的点阵为：宽x高=9x16   --*/
0xE0,0xF0,0x18,0x08,0x08,0x18,0xF0,0xE0,0x00,0x0F,0x1F,0x30,0x20,0x20,0x30,0x1F,
0x0F,0x00,


/*--  文字:  A  --*/
/*--  宋体12;  此字体下对应的点阵为：宽x高=9x16   --*/
0x00,0x00,0xC0,0xF8,0xF8,0xE0,0x00,0x00,0x00,0x20,0x3C,0x3F,0x23,0x02,0x27,0x3F,
0x38,0x20,



};



	//0-9
uint8_t T_number[10][18]=
  {
	
/*--  文字:  0  --*/
/*--  宋体12;  此字体下对应的点阵为：宽x高=9x16   --*/
0x00,0xE0,0xF0,0x18,0x08,0x18,0xF0,0xE0,0x00,0x00,0x0F,0x1F,0x30,0x20,0x30,0x1F,
0x0F,0x00,

/*--  文字:  1  --*/
/*--  宋体12;  此字体下对应的点阵为：宽x高=9x16   --*/
0x00,0x00,0x10,0x10,0xF8,0xF8,0x00,0x00,0x00,0x00,0x00,0x20,0x20,0x3F,0x3F,0x20,
0x20,0x00,

/*--  文字:  2  --*/
/*--  宋体12;  此字体下对应的点阵为：宽x高=9x16   --*/
0x00,0x70,0x78,0x08,0x08,0x08,0xF8,0xF0,0x00,0x00,0x30,0x38,0x2C,0x26,0x23,0x31,
0x30,0x00,

/*--  文字:  3  --*/
/*--  宋体12;  此字体下对应的点阵为：宽x高=9x16   --*/
0x00,0x30,0x38,0x08,0x08,0x88,0xF8,0x70,0x00,0x00,0x18,0x38,0x21,0x21,0x23,0x3E,
0x1C,0x00,

/*--  文字:  4  --*/
/*--  宋体12;  此字体下对应的点阵为：宽x高=9x16   --*/
0x00,0x00,0x80,0xC0,0x70,0xF8,0xF8,0x00,0x00,0x00,0x06,0x07,0x25,0x24,0x3F,0x3F,
0x24,0x24,

/*--  文字:  5  --*/
/*--  宋体12;  此字体下对应的点阵为：宽x高=9x16   --*/
0x00,0xF8,0xF8,0x88,0x88,0x88,0x08,0x08,0x00,0x00,0x19,0x39,0x20,0x20,0x31,0x1F,
0x0E,0x00,

/*--  文字:  6  --*/
/*--  宋体12;  此字体下对应的点阵为：宽x高=9x16   --*/
0x00,0xE0,0xF0,0x98,0x88,0x98,0x90,0x00,0x00,0x00,0x0F,0x1F,0x31,0x20,0x20,0x3F,
0x1F,0x00,

/*--  文字:  7  --*/
/*--  宋体12;  此字体下对应的点阵为：宽x高=9x16   --*/
0x00,0x18,0x18,0x08,0x88,0xE8,0x78,0x18,0x00,0x00,0x00,0x00,0x3E,0x3F,0x01,0x00,
0x00,0x00,

/*--  文字:  8  --*/
/*--  宋体12;  此字体下对应的点阵为：宽x高=9x16   --*/
0x00,0x70,0xF8,0x88,0x08,0x88,0xF8,0x70,0x00,0x00,0x1C,0x3E,0x23,0x21,0x23,0x3E,
0x1C,0x00,

/*--  文字:  9  --*/
/*--  宋体12;  此字体下对应的点阵为：宽x高=9x16   --*/
0x00,0xF0,0xF8,0x08,0x08,0x18,0xF0,0xE0,0x00,0x00,0x01,0x13,0x32,0x22,0x33,0x1F,
0x0F,0x00,


  };
	
	
/*引脚初始化*/
void OLED_I2C_Init(void)
{
    
	
	GPIO_InitTypeDef GPIO_InitStructure;
	RCC_APB2PeriphClockCmd(RCC_APB2Periph_GPIOB, ENABLE);
 	GPIO_InitStructure.GPIO_Mode = GPIO_Mode_Out_OD;
	GPIO_InitStructure.GPIO_Speed = GPIO_Speed_50MHz;
	GPIO_InitStructure.GPIO_Pin = GPIO_Pin_8;
 	GPIO_Init(GPIOB, &GPIO_InitStructure);
	GPIO_InitStructure.GPIO_Pin = GPIO_Pin_9;
 	GPIO_Init(GPIOB, &GPIO_InitStructure);
	
	OLED_W_SCL(1);
	OLED_W_SDA(1);
}

/**
  * @brief  I2C开始
  * @param  无
  * @retval 无
  */
void OLED_I2C_Start(void)
{
	OLED_W_SDA(1);
	OLED_W_SCL(1);
	OLED_W_SDA(0);
	OLED_W_SCL(0);
}

/**
  * @brief  I2C停止
  * @param  无
  * @retval 无
  */
void OLED_I2C_Stop(void)
{
	OLED_W_SDA(0);
	OLED_W_SCL(1);
	OLED_W_SDA(1);
}

/**
  * @brief  I2C发送一个字节
  * @param  Byte 要发送的一个字节
  * @retval 无
  */
void OLED_I2C_SendByte(uint8_t Byte)
{
	uint8_t i;
	for (i = 0; i < 8; i++)
	{
		OLED_W_SDA(Byte & (0x80 >> i));
		OLED_W_SCL(1);
		OLED_W_SCL(0);
	}
	OLED_W_SCL(1);	//额外的一个时钟，不处理应答信号
	OLED_W_SCL(0);
}

/**
  * @brief  OLED写命令
  * @param  Command 要写入的命令
  * @retval 无
  */
void OLED_WriteCommand(uint8_t Command)
{
	OLED_I2C_Start();
	OLED_I2C_SendByte(0x78);		//从机地址
	OLED_I2C_SendByte(0x00);		//写命令
	OLED_I2C_SendByte(Command); 
	OLED_I2C_Stop();
}

/**
  * @brief  OLED写数据
  * @param  Data 要写入的数据
  * @retval 无
  */
void OLED_WriteData(uint8_t Data)
{
	OLED_I2C_Start();
	OLED_I2C_SendByte(0x78);		//从机地址
	OLED_I2C_SendByte(0x40);		//写数据
	OLED_I2C_SendByte(Data);
	OLED_I2C_Stop();
}

/**
  * @brief  OLED设置光标位置
  * @param  Y 以左上角为原点，向下方向的坐标，范围：0~7
  * @param  X 以左上角为原点，向右方向的坐标，范围：0~127
  * @retval 无
  */
void OLED_SetCursor(uint8_t Y, uint8_t X)
{
	OLED_WriteCommand(0xB0 | Y);					//设置Y位置
	OLED_WriteCommand(0x10 | ((X & 0xF0) >> 4));	//设置X位置高4位
	OLED_WriteCommand(0x00 | (X & 0x0F));			//设置X位置低4位
}

/**
  * @brief  OLED清屏
  * @param  无
  * @retval 无
  */
void OLED_Clear(void)
{  
	uint8_t i, j;
	for (j = 0; j < 8; j++)
	{
		OLED_SetCursor(j, 0);
		for(i = 0; i < 128; i++)
		{
			OLED_WriteData(0x00);
		}
	}
}

/**
  * @brief  OLED显示一个字符
  * @param  Line 行位置，范围：1~4
  * @param  Column 列位置，范围：1~16
  * @param  Char 要显示的一个字符，范围：ASCII可见字符
  * @retval 无
  */
void OLED_ShowChar(uint8_t Line, uint8_t Column, char Char)
{      	
	uint8_t i;
	OLED_SetCursor((Line - 1) * 2, (Column - 1) * 8);		//设置光标位置在上半部分
	for (i = 0; i < 8; i++)
	{
		OLED_WriteData(OLED_F8x16[Char - ' '][i]);			//显示上半部分内容
	}
	OLED_SetCursor((Line - 1) * 2 + 1, (Column - 1) * 8);	//设置光标位置在下半部分
	for (i = 0; i < 8; i++)
	{
		OLED_WriteData(OLED_F8x16[Char - ' '][i + 8]);		//显示下半部分内容
	}
}

/**
  * @brief  OLED显示字符串
  * @param  Line 起始行位置，范围：1~4
  * @param  Column 起始列位置，范围：1~16
  * @param  String 要显示的字符串，范围：ASCII可见字符
  * @retval 无
  */
void OLED_ShowString(uint8_t Line, uint8_t Column, char *String)
{
	uint8_t i;
	for (i = 0; String[i] != '\0'; i++)
	{
		OLED_ShowChar(Line, Column + i, String[i]);
	}
}

/**
  * @brief  OLED次方函数
  * @retval 返回值等于X的Y次方
  */
uint32_t OLED_Pow(uint32_t X, uint32_t Y)
{
	uint32_t Result = 1;
	while (Y--)
	{
		Result *= X;
	}
	return Result;
}

/**
  * @brief  OLED显示数字（十进制，正数）
  * @param  Line 起始行位置，范围：1~4
  * @param  Column 起始列位置，范围：1~16
  * @param  Number 要显示的数字，范围：0~4294967295
  * @param  Length 要显示数字的长度，范围：1~10
  * @retval 无
  */
void OLED_ShowNum(uint8_t Line, uint8_t Column, uint32_t Number, uint8_t Length)
{
	uint8_t i;
	for (i = 0; i < Length; i++)							
	{
		OLED_ShowChar(Line, Column + i, Number / OLED_Pow(10, Length - i - 1) % 10 + '0');
	}
}

/**
  * @brief  OLED显示数字（十进制，带符号数）
  * @param  Line 起始行位置，范围：1~4
  * @param  Column 起始列位置，范围：1~16
  * @param  Number 要显示的数字，范围：-2147483648~2147483647
  * @param  Length 要显示数字的长度，范围：1~10
  * @retval 无
  */
void OLED_ShowSignedNum(uint8_t Line, uint8_t Column, int32_t Number, uint8_t Length)
{
	uint8_t i;
	uint32_t Number1;
	if (Number >= 0)
	{
		OLED_ShowChar(Line, Column, '+');
		Number1 = Number;
	}
	else
	{
		OLED_ShowChar(Line, Column, '-');
		Number1 = -Number;
	}
	for (i = 0; i < Length; i++)							
	{
		OLED_ShowChar(Line, Column + i + 1, Number1 / OLED_Pow(10, Length - i - 1) % 10 + '0');
	}
}

/**
  * @brief  OLED显示数字（十六进制，正数）
  * @param  Line 起始行位置，范围：1~4
  * @param  Column 起始列位置，范围：1~16
  * @param  Number 要显示的数字，范围：0~0xFFFFFFFF
  * @param  Length 要显示数字的长度，范围：1~8
  * @retval 无
  */
void OLED_ShowHexNum(uint8_t Line, uint8_t Column, uint32_t Number, uint8_t Length)
{
	uint8_t i, SingleNumber;
	for (i = 0; i < Length; i++)							
	{
		SingleNumber = Number / OLED_Pow(16, Length - i - 1) % 16;
		if (SingleNumber < 10)
		{
			OLED_ShowChar(Line, Column + i, SingleNumber + '0');
		}
		else
		{
			OLED_ShowChar(Line, Column + i, SingleNumber - 10 + 'A');
		}
	}
}

/**
  * @brief  OLED显示数字（二进制，正数）
  * @param  Line 起始行位置，范围：1~4
  * @param  Column 起始列位置，范围：1~16
  * @param  Number 要显示的数字，范围：0~1111 1111 1111 1111
  * @param  Length 要显示数字的长度，范围：1~16
  * @retval 无
  */
void OLED_ShowBinNum(uint8_t Line, uint8_t Column, uint32_t Number, uint8_t Length)
{
	uint8_t i;
	for (i = 0; i < Length; i++)							
	{
		OLED_ShowChar(Line, Column + i, Number / OLED_Pow(2, Length - i - 1) % 2 + '0');
	}
}

/**
  * @brief  OLED初始化
  * @param  无
  * @retval 无
  */
void OLED_Init(void)
{
	uint32_t i, j;
	
	for (i = 0; i < 1000; i++)			//上电延时
	{
		for (j = 0; j < 1000; j++);
	}
	
	OLED_I2C_Init();			//端口初始化
	
	OLED_WriteCommand(0xAE);	//关闭显示
	
	OLED_WriteCommand(0xD5);	//设置显示时钟分频比/振荡器频率
	OLED_WriteCommand(0x80);
	
	OLED_WriteCommand(0xA8);	//设置多路复用率
	OLED_WriteCommand(0x3F);
	
	OLED_WriteCommand(0xD3);	//设置显示偏移
	OLED_WriteCommand(0x00);
	
	OLED_WriteCommand(0x40);	//设置显示开始行
	
	OLED_WriteCommand(0xA1);	//设置左右方向，0xA1正常 0xA0左右反置
	
	OLED_WriteCommand(0xC8);	//设置上下方向，0xC8正常 0xC0上下反置

	OLED_WriteCommand(0xDA);	//设置COM引脚硬件配置
	OLED_WriteCommand(0x12);
	
	OLED_WriteCommand(0x81);	//设置对比度控制
	OLED_WriteCommand(0xCF);

	OLED_WriteCommand(0xD9);	//设置预充电周期
	OLED_WriteCommand(0xF1);

	OLED_WriteCommand(0xDB);	//设置VCOMH取消选择级别
	OLED_WriteCommand(0x30);

	OLED_WriteCommand(0xA4);	//设置整个显示打开/关闭

	OLED_WriteCommand(0xA6);	//设置正常/倒转显示

	OLED_WriteCommand(0x8D);	//设置充电泵
	OLED_WriteCommand(0x14);

	OLED_WriteCommand(0xAF);	//开启显示
		
	OLED_Clear();				//OLED清屏
}

/*
*********************************************************************************************************
*	函 数 名: OLED_Write_Display
*	功能说明: 
坐标 X Y 高度 g 宽度 k  数据 *dat
*	形    参:  无
*	返 回 值: 无
*********************************************************************************************************
*/
void OLED_Write_Display(uint8_t x,uint8_t y,uint8_t g,uint8_t k,uint8_t *dat)
{
	int i,j;
	for(i = 0;i<g;i++)
	{
		 OLED_WriteCommand((0xB0|i)+x);//显示开启
		OLED_WriteCommand(0x10+(y>>4&0x0f));//显示开启
		OLED_WriteCommand(y&0x0f);//显示开启
		
		for(j=0;j<k;j++)
		{
			OLED_WriteData(*dat++);
		}
	}
	
}

/*
*********************************************************************************************************
*	函 数 名: OLED_Write_Display
*	功能说明: 
坐标 X Y 高度 g 宽度 k  数据 *dat
*	形    参:  无
*	返 回 值: 无
*********************************************************************************************************
*/
void OLED_Write_Number(uint8_t x, uint8_t y, uint8_t Num)
{

	
	//每页的高度 为8,  32的高度需要占用4页
	OLED_Write_Display( x,y, 2,9,T_number[Num]);

	
}

/*
*********************************************************************************************************
*	函 数 名: Lora_TH_Display
*	功能说明: 
显示温湿度和LORA节点
*	形    参:  无
*	返 回 值: 无
*********************************************************************************************************
*/

void Lora_TH_Display(void)
{
	
	//LORA节点
		OLED_Write_Display(0,16,2,9,Tep_char[4]);
	OLED_Write_Display(0,25,2,9,Tep_char[5]);
	OLED_Write_Display(0,34,2,9,Tep_char[2]);
	OLED_Write_Display(0,43,2,9,Tep_char[6]);
	OLED_Write_Display(0,52,2,17,T_text[5]);
	OLED_Write_Display(0,70,2,17,T_text[6]);

//温湿度

	OLED_Write_Display(3,0,2,17,Tep_text[0]);
	OLED_Write_Display(3,18,2,17,Tep_text[1]);
	OLED_Write_Display(3,38,2,17,Tep_text[2]);
	OLED_Write_Display(3,64,2,9,Tep_char[0]);
	OLED_Write_Display(3,82,2,17,Tep_text[5]);
	
	OLED_Write_Display(5,0,2,17,Tep_text[3]);
	OLED_Write_Display(5,18,2,17,Tep_text[4]);
	OLED_Write_Display(5,38,2,17,Tep_text[2]);
	OLED_Write_Display(5,64,2,9,Tep_char[0]);
	OLED_Write_Display(5,82,2,9,Tep_char[1]);
	OLED_Write_Display(5,90,2,9,Tep_char[2]);
	OLED_Write_Display(5,99,2,9,Tep_char[3]);
	
				OLED_Write_Number(3,48,(int)Temp_value / 10);
			OLED_Write_Number(3,56,(int)Temp_value % 10);
			OLED_Write_Number(3,72,(int)(Temp_value * 10) %10);
			OLED_Write_Number(5,48,6);
			OLED_Write_Number(5,56,6);
			OLED_Write_Number(5,72,6);
}
